## conf/layer.conf
```bitbake
# We have a conf and classes directory, add to BBPATH
BBPATH .= ":${LAYERDIR}"

# We have a recipes-* directories, add to BBFILES
BBFILES += "${LAYERDIR}/recipes-*/*/*.bb \
	${LAYERDIR}/recipes-*/*/*.bbappend"

BBFILE_COLLECTIONS += "wiipiido-layer"
BBFILE_PATTERN_wiipiido-layer = "^${LAYERDIR}/"
BBFILE_PRIORITY_wiipiido-layer = "5"

LAYERSERIES_COMPAT_wiipiido-layer = "thud warrior"
```

## meta-gw/conf/layer.conf
```bitbake
# We have a conf and classes directory, add to BBPATH
BBPATH .= ":${LAYERDIR}"

# We have recipes-* directories, add to BBFILES
BBFILES += "${LAYERDIR}/recipes-*/*/*.bb \
            ${LAYERDIR}/recipes-*/*/*.bbappend"

BBFILE_COLLECTIONS += "meta-gw"
BBFILE_PATTERN_meta-gw = "^${LAYERDIR}/"
BBFILE_PRIORITY_meta-gw = "6"

LAYERDEPENDS_meta-gw = "core"
LAYERSERIES_COMPAT_meta-gw = "warrior"
```

## meta-wiipiido/conf/machine/wiipiido.conf
```bitbake
#@TYPE: Machine
#@NAME: WIIPIIDO Board
#@DESCRIPTION: An Allwinner based development board http://www.globaltronic.pt/en/product/wiipiido/

require conf/machine/include/arm/arch-arm64.inc

PREFERRED_PROVIDER_virtual/bootloader ?= "u-boot"
EXTRA_IMAGEDEPENDS += "u-boot"
UBOOT_MACHINE ?= "wiipiido_defconfig"
UBOOT_BINARY ?= "u-boot-sunxi-with-spl.bin"
UBOOT_ENV ?= "boot"
UBOOT_ENV_SUFFIX ?= "scr"
SPL_BINARY ?= "spl/sunxi-spl.bin"
UBOOT_ENTRYPOINT = "0x40080000"
UBOOT_DTB_LOADADDRESS = "0x4FA00000"

PREFERRED_PROVIDER_virtual/kernel ?= "linux-wiipiido"
PREFERRED_VERSION_linux-wiipiido ?= "4.19%"
KERNEL_CLASSES = "kernel-fitimage"
KERNEL_IMAGETYPE = "fitImage"
KERNEL_DEVICETREE = "allwinner/sun50i-a64-wiipiido.dtb"

MACHINE_EXTRA_RRECOMMENDS += "kernel-modules"
MACHINE_EXTRA_RRECOMMENDS += "linux-firmware-brcm43430"

IMAGE_FSTYPES += "wic"
WKS_FILE ?= "wiipiido-bsp-image.wks"

IMAGE_BOOT_FILES ?= " \
    fitImage \
    boot.scr \
    "

WKS_FILE_DEPENDS ?= " \
    mtools-native \
    dosfstools-native \
    virtual/bootloader \
    virtual/kernel \
    "

SERIAL_CONSOLES = "115200;ttyS0"
MACHINE_FEATURES = "alsa apm keyboard rtc serial screen touchscreen usbgadget usbhost vfat ext2 ext3 wifi"
```
